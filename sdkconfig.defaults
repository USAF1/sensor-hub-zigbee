## sdkconfig.defaults
```kconfig
#
# Partition Table
#
CONFIG_PARTITION_TABLE_CUSTOM=y
CONFIG_PARTITION_TABLE_CUSTOM_FILENAME="partitions.csv"
CONFIG_PARTITION_TABLE_FILENAME="partitions.csv"
CONFIG_PARTITION_TABLE_OFFSET=0x8000
CONFIG_PARTITION_TABLE_MD5=y
# end of Partition Table

#
# Serial flasher config
#
CONFIG_ESPTOOLPY_FLASHSIZE_4MB=y
# end of Serial flasher config

#
# Event
#
CONFIG_ESP_SYSTEM_EVENT_TASK_STACK_SIZE=4096
#end of Event

#
# Zigbee
#
CONFIG_ZB_ENABLED=y
CONFIG_ZB_ZCZR=y
CONFIG_ZB_EXAMPLE_PRIMARY_CHANNEL=15
CONFIG_ZB_EXAMPLE_SECONDARY_CHANNEL_MASK=0
# end of Zigbee
```
